## app/boards/shields/keaboard/Kconfig.defconfig
```kconfig
# Copyright (c) 2020 Keith Wade
# SPDX-License-Identifier: MIT

if SHIELD_KEABOARD_LEFT

config ZMK_KEYBOARD_NAME
	default "Keaboard Left"

endif

if SHIELD_KEABOARD_RIGHT

config ZMK_KEYBOARD_NAME
	default "Keaboard Right"

endif
```

## app/boards/shields/keaboard/Kconfig.shield
```kconfig
# Copyright (c) 2020 Keith Wade
# SPDX-License-Identifier: MIT

config SHIELD_KEABOARD_LEFT
	def_bool $(shields_list_contains,keaboard_left)

config SHIELD_KEABOARD_RIGHT
	def_bool $(shields_list_contains,keaboard_right)
```
