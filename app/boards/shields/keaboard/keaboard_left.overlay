/*
 * Copyright (c) 2020 Keith Wade
 *
 * SPDX-License-Identifier: MIT
 */

#include "keaboard.dtsi"

&kscan0 {
	col-gpios
		= <&pro_micro_a 2 GPIO_ACTIVE_HIGH>
		, <&pro_micro_d 1 GPIO_ACTIVE_HIGH>
		, <&pro_micro_a 0 GPIO_ACTIVE_HIGH>
		, <&pro_micro_d 15 GPIO_ACTIVE_HIGH>
		, <&pro_micro_d 14 GPIO_ACTIVE_HIGH>
		, <&pro_micro_d 16 GPIO_ACTIVE_HIGH>
		, <&pro_micro_d 10 GPIO_ACTIVE_HIGH>
		;
};

&bt_unpair_combo {
	key-positions = <0 48>;
};
